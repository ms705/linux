## dios/Kconfig
```kconfig
menuconfig DIOS
	bool "DIOS extensions"
	default n
	help
	  Enable DIOS syscalls, PCB additions and program lifecycle hooks.

if DIOS

config DIOS_DEATH_ON_LEGACY_MISUSE
	bool "Death penalty for legacy syscall misuse"
	default n
	help
	  If a pure DIOS task makes a legacy syscall then it should be killed.

config DIOS_RESTRICT_LIMBO
	bool "Restrict limbo programs"
	default n
	help
	  Prevent limbo programs from making DIOS syscalls.

config DIOS_DEBUG_VERBOSE
	bool "Verbose debug output"
	default n
	help
	  Produce noisy debug output from DIOS kernel code.

endif
```
